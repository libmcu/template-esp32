## ports/esp-idf/sdkconfig.defaults
```kconfig
CONFIG_PARTITION_TABLE_CUSTOM=y
CONFIG_PARTITION_TABLE_CUSTOM_FILENAME="ports/esp-idf/partitions.csv"
CONFIG_PARTITION_TABLE_FILENAME="ports/esp-idf/partitions.csv"
CONFIG_PARTITION_TABLE_OFFSET=0xE000

CONFIG_ESPTOOLPY_FLASHSIZE_8MB=y

CONFIG_BOOTLOADER_APP_ROLLBACK_ENABLE=y
```
